## CMakeLists.txt
```
cmake_minimum_required(VERSION 3.20.0)

find_package(Zephyr REQUIRED HINTS $ENV{ZEPHYR_BASE})

project(Q29uY2x1c2l2ZSBFbmdpbmVlcmluZw)
add_subdirectory(src)
```

## Kconfig
```
mainmenu "Q29uY2x1c2l2ZSBFbmdpbmVlcmluZw"

# bluetooth module
config BT_ADV_UUID_TIME_LOW
    hex "BLE advertising UUID time-low section value"

config BT_ADV_UUID_TIME_MID
    hex "BLE advertising UUID time-mid section value"

config BT_ADV_UUID_TIME_HIGH_AND_VERSION
    hex "BLE advertising UUID time-high-and-version section value"

config BT_ADV_UUID_CLOCK_SEQUENCE_HI_AND_RES_CLOCK_SEQUENCE_LOW
    hex "BLE advertising UUID clock-seq-and-reserved && clock-seq-low section value"

config BT_ADV_UUID_NODE
    hex "BLE advertising UUID node section value"

config BT_SERVICE_UUID_TIME_LOW
    hex "BLE advertising UUID time-low section value"

config BT_SERVICE_UUID_TIME_MID
    hex "BLE advertising UUID time-mid section value"

config BT_SERVICE_UUID_TIME_HIGH_AND_VERSION
    hex "BLE advertising UUID time-high-and-version section value"

config BT_SERVICE_UUID_CLOCK_SEQUENCE_HI_AND_RES_CLOCK_SEQUENCE_LOW
    hex "BLE advertising UUID clock-seq-and-reserved && clock-seq-low section value"

config BT_SERVICE_UUID_NODE
    hex "BLE advertising UUID node section value"

config BT_SERVICE_RX_UUID_TIME_LOW
    hex "BLE advertising UUID time-low section value"

config BT_SERVICE_RX_UUID_TIME_MID
    hex "BLE advertising UUID time-mid section value"

config BT_SERVICE_RX_UUID_TIME_HIGH_AND_VERSION
    hex "BLE advertising UUID time-high-and-version section value"

config BT_SERVICE_RX_UUID_CLOCK_SEQUENCE_HI_AND_RES_CLOCK_SEQUENCE_LOW
    hex "BLE advertising UUID clock-seq-and-reserved && clock-seq-low section value"

config BT_SERVICE_RX_UUID_NODE
    hex "BLE advertising UUID node section value"

config BT_SERVICE_TX_UUID_TIME_LOW
    hex "BLE advertising UUID time-low section value"

config BT_SERVICE_TX_UUID_TIME_MID
    hex "BLE advertising UUID time-mid section value"

config BT_SERVICE_TX_UUID_TIME_HIGH_AND_VERSION
    hex "BLE advertising UUID time-high-and-version section value"

config BT_SERVICE_TX_UUID_CLOCK_SEQUENCE_HI_AND_RES_CLOCK_SEQUENCE_LOW
    hex "BLE advertising UUID clock-seq-and-reserved && clock-seq-low section value"

config BT_SERVICE_TX_UUID_NODE
    hex "BLE advertising UUID node section value"

# sensor module
config SENSOR_THREAD_STACK_SIZE
    int "Sensor thread stack size"

config SENSOR_THREAD_PRIORITY
    int "Sensor thread priority"

config SENSOR_THREAD_PERIOD_DEFAULT_VALUE
    int "Default period of the sensor thread in milliseconds"

source "Kconfig.zephyr"
```

## prj.conf
```kconfig
CONFIG_STDOUT_CONSOLE=y
CONFIG_CBPRINTF_FP_SUPPORT=y

CONFIG_BT=y
CONFIG_BT_DEVICE_NAME="Q29uY2x1c2l2ZSBFbmdpbmVlcmluZw=="
CONFIG_BT_MAX_CONN=1
CONFIG_BT_PERIPHERAL=y

CONFIG_BT_ADV_UUID_TIME_LOW=0xD34DB33F
CONFIG_BT_ADV_UUID_TIME_MID=0x1337
CONFIG_BT_ADV_UUID_TIME_HIGH_AND_VERSION=0x1234
CONFIG_BT_ADV_UUID_CLOCK_SEQUENCE_HI_AND_RES_CLOCK_SEQUENCE_LOW=0x5678
CONFIG_BT_ADV_UUID_NODE=0xAABBCCDDEEFF

CONFIG_BT_SERVICE_UUID_TIME_LOW=0x12345678
CONFIG_BT_SERVICE_UUID_TIME_MID=0x1234
CONFIG_BT_SERVICE_UUID_TIME_HIGH_AND_VERSION=0x1234
CONFIG_BT_SERVICE_UUID_CLOCK_SEQUENCE_HI_AND_RES_CLOCK_SEQUENCE_LOW=0x1234
CONFIG_BT_SERVICE_UUID_NODE=0xAABBCCDDEEFF

CONFIG_BT_SERVICE_RX_UUID_TIME_LOW=0x12345679
CONFIG_BT_SERVICE_RX_UUID_TIME_MID=0x1234
CONFIG_BT_SERVICE_RX_UUID_TIME_HIGH_AND_VERSION=0x1234
CONFIG_BT_SERVICE_RX_UUID_CLOCK_SEQUENCE_HI_AND_RES_CLOCK_SEQUENCE_LOW=0x1234
CONFIG_BT_SERVICE_RX_UUID_NODE=0xAABBCCDDEEFF

CONFIG_BT_SERVICE_TX_UUID_TIME_LOW=0x1234567A
CONFIG_BT_SERVICE_TX_UUID_TIME_MID=0x1234
CONFIG_BT_SERVICE_TX_UUID_TIME_HIGH_AND_VERSION=0x1234
CONFIG_BT_SERVICE_TX_UUID_CLOCK_SEQUENCE_HI_AND_RES_CLOCK_SEQUENCE_LOW=0x1234
CONFIG_BT_SERVICE_TX_UUID_NODE=0xAABBCCDDEEFF

CONFIG_I2C=y
CONFIG_SENSOR=y
CONFIG_LPS22HB=y

CONFIG_SENSOR_THREAD_STACK_SIZE=512
CONFIG_SENSOR_THREAD_PRIORITY=1
CONFIG_SENSOR_THREAD_PERIOD_DEFAULT_VALUE=200
```

## src/main.c
```c
#include <stdio.h>
#include <zephyr.h>

#include "bluetooth.h"
#include "sensor.h"

/*
 *
 */
static void _on_sensor_data(float_t pressure, float_t temperature)
{
    char buf[64];
    size_t len = snprintf(buf, sizeof(buf), "Pressure: %f Temperature: %f\n", pressure, temperature);
    (void) bluetooth_send(buf, len);
}

/*
 *
 */
void main(void)
{
    (void) bluetooth_init(NULL);

    sensor_cb_t sensor_cb = { .on_data = _on_sensor_data };
    (void) sensor_init(&sensor_cb);
}
```
